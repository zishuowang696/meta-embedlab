## conf/distro/tinyai.conf
```bitbake
# TinyAI 发行版配置
# 继承自 poky，默认包含 llama-cpp（LLM 推理引擎）

require conf/distro/poky.conf

DISTRO_NAME = "TinyAI"
DISTRO_VERSION = "1.0.0"
DISTRO_CODENAME = "tinyai"

# 默认集成 llama-cpp + Qwen2.5-0.5B 量化模型到所有镜像
DISTRO_EXTRA_RDEPENDS += "llama-cpp tinyai-model-qwen"

# 使用 OpenRC 作为 init 系统（轻量、并行启动）
INIT_MANAGER = "openrc"

# 使用 musl libc（减少体积，适合嵌入式）
TCLIBC = "musl"

# 排除不需要的 DISTRO_FEATURES（减小构建体积和依赖）
DISTRO_FEATURES_OPTED_OUT = "x11 wayland"
```

## conf/layer.conf
```bitbake
# 1. 让 BitBake 能找到这个层
BBPATH .= ":${LAYERDIR}"

# 2. 告诉 BitBake 解析哪些配方文件
BBFILES += "${LAYERDIR}/recipes-*/*/*.bb"

# 3. 动态加载 bbappend（仅在对应层存在时加载）
# core 层包含 sysvinit, tiny-init, busybox 等
BBFILES_DYNAMIC += "core:${LAYERDIR}/recipes-core/*/*.bbappend"
BBFILES_DYNAMIC += "core:${LAYERDIR}/recipes-kernel/*/*.bbappend"

# 4. 给这个层起个名字叫 "embedlab"
BBFILE_COLLECTIONS += "embedlab"

# 5. 匹配规则：路径以层目录开头的文件都属于 embedlab 层
BBFILE_PATTERN_embedlab = "^${LAYERDIR}/"

# 6. 优先级设为 6（高于默认的 5）
BBFILE_PRIORITY_embedlab = "6"

# 7. 这个层依赖 OE-Core 的 meta 层
LAYERDEPENDS_embedlab = "core"

# 8. 兼容 Yocto 最新版本 (master/wrynose)
LAYERSERIES_COMPAT_embedlab = "wrynose"

# 9. 自定义变量：产品版本号
EMBEDLAB_VERSION = "1.0.0"
```
